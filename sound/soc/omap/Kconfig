## sound/soc/omap/Kconfig
```kconfig
menu "SoC Audio for the Texas Instruments OMAP"

config SND_OMAP_SOC
	tristate "SoC Audio for the Texas Instruments OMAP chips"
	depends on ARCH_OMAP && SND_SOC

config SND_OMAP_SOC_MCBSP
	tristate
	select OMAP_MCBSP

config SND_OMAP_SOC_N810
	tristate "SoC Audio support for Nokia N810"
	depends on SND_OMAP_SOC && MACH_NOKIA_N810
	select SND_OMAP_SOC_MCBSP
	select SND_SOC_TLV320AIC3X
	help
	  Say Y if you want to add support for SoC audio on Nokia N810.

config SND_OMAP_SOC_OMAP3EVM
	tristate "SoC Audio support for OMAP3 EVM"
	depends on SND_OMAP_SOC && MACH_OMAP3EVM
	select SND_OMAP_SOC_MCBSP
	select SND_SOC_TWL4030
	help
	  Say Y if you want to add support for SoC audio on the OMAP3 EVM.

config SND_OMAP_SOC_OMAP3BEAGLE
	tristate "SoC Audio support for OMAP3 Beagle"
	depends on SND_OMAP_SOC && MACH_OMAP3_BEAGLE
	select SND_OMAP_SOC_MCBSP
	select SND_SOC_TWL4030
	help
	  Say Y if you want to add support for SoC audio on the OMAP3 Beagle.

config SND_OMAP_SOC_OMAP3PANDORA
	tristate "SoC Audio support for OMAP3 Pandora"
	depends on SND_OMAP_SOC && MACH_OMAP3_PANDORA
	select SND_OMAP_SOC_MCBSP
	select SND_SOC_TWL4030
	help
	  Say Y if you want to add support for SoC audio on the OMAP3 Pandora.

endmenu
```
